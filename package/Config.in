## package/Config.in
```kconfig
menu "Python Host packages"
	source "$BR2_EXTERNAL_ROS_PATH/package/python-pyparsing-host/Config.in"
	source "$BR2_EXTERNAL_ROS_PATH/package/python-numpy-host/Config.in"
endmenu

menu "Python packages"
	source "$BR2_EXTERNAL_ROS_PATH/package/python-empy/Config.in"
	source "$BR2_EXTERNAL_ROS_PATH/package/python-bson/Config.in"
	source "$BR2_EXTERNAL_ROS_PATH/package/python-vcstools/Config.in"
	source "$BR2_EXTERNAL_ROS_PATH/package/python-wstool/Config.in"
endmenu

source "$BR2_EXTERNAL_ROS_PATH/package/ros/Config.in"
```

## package/ros/class-loader/Config.in
```kconfig
config BR2_PACKAGE_CLASS_LOADER
	bool
	select BR2_PACKAGE_POCO
	select BR2_PACKAGE_BOOST_THREAD
	select BR2_PACKAGE_BOOST_SYSTEM
```
